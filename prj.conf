## CMakeLists.txt
```
#
# Copyright (c) 2025 Nordic Semiconductor ASA
#
# SPDX-License-Identifier: LicenseRef-Nordic-5-Clause
#
cmake_minimum_required(VERSION 3.20.0)

find_package(Zephyr REQUIRED HINTS $ENV{ZEPHYR_BASE})
project(NONE)

zephyr_library_include_directories(${ZEPHYR_BASE}/subsys/bluetooth/mesh)
zephyr_library_include_directories(${ZEPHYR_NRF_MODULE_DIR}/subsys/bluetooth/mesh)

# # Include source files
# target_sources(app PRIVATE
#   src/main.c
#   src/model_handler.c
#   src/vnd_cli.c
#   src/vnd_srv.c
# )

FILE(GLOB app_sources src/*.c)
target_sources(app PRIVATE ${app_sources})


# Include directories
target_include_directories(app PRIVATE include)
```

## Kconfig
```
#
# Copyright (c) 2018 Nordic Semiconductor
#
# SPDX-License-Identifier: LicenseRef-Nordic-5-Clause
#

source "Kconfig.zephyr"

menu "Nordic nus&mesh sample"

config FW_VERSION
	string "firmware version"
	default "1.0.0"
	help
	  Application firmware version. 

config BT_NUS_CRLF_UART_TERMINATION
	bool "Use CR or LF to terminate UART transactions"
	default y
	help
	  "Use CR or LF to terminate UART transactions. Disable to send data regardless after a timeout."

config BT_NUS_ADVERTISING_INTERVAL
	int "Advertising interval"
	default 500
	help
	  Advertising interval in milliseconds

config BT_NUS_THREAD_STACK_SIZE
	int "Thread stack size"
	default 1024
	help
	  Stack size used in each of the two threads

config BT_NUS_UART_BUFFER_SIZE
	int "UART payload buffer element size"
	default 40
	help
	  Size of the payload buffer in each RX and TX FIFO element

config BT_NUS_SECURITY_ENABLED
	bool "Enable security"
	default y
	select BT_SMP
	help
	  "Enable BLE security for the UART service"

config BT_NUS_UART_RX_WAIT_TIME
	int "Timeout for UART RX complete event"
	default 50000
	help
	  Wait for RX complete event time in microseconds

config BT_NUS_FIXED_PASSKEY
	int "Define the default passkey for NUS"
	depends on BT_FIXED_PASSKEY
	default 123456
	help
	  Define the default password for pairing with the Bluetooth LE device.

config SETTINGS
	default y

config ZMS
	default y if (SOC_FLASH_NRF_RRAM || SOC_FLASH_NRF_MRAM)

config NVS
	default y if !(SOC_FLASH_NRF_RRAM || SOC_FLASH_NRF_MRAM)

endmenu
```

## sample.yaml
```
sample:
  name: Bluetooth Mesh Vendor Model Demo
  description: Bluetooth Mesh vendor model demonstration application
tests:
  sample.bluetooth.mesh_vendor_model_demo:
    build_only: true
    build_on_all: true
    platform_allow: nrf52dk_nrf52832 nrf52840dk_nrf52840 nrf5340dk_nrf5340_cpuapp
    integration_platforms:
      - nrf52dk_nrf52832
      - nrf52840dk_nrf52840
      - nrf5340dk_nrf5340_cpuapp
    tags: bluetooth
```

## prj.conf
```kconfig
#
# Copyright (c) 2025 Nordic Semiconductor ASA
#
# SPDX-License-Identifier: LicenseRef-Nordic-5-Clause
#

CONFIG_FW_VERSION="1.1.2"

CONFIG_NCS_SAMPLES_DEFAULTS=y

# Deferred logging helps improve power consumption
CONFIG_LOG_MODE_DEFERRED=y

CONFIG_REBOOT=y
CONFIG_BT_NUS_CRLF_UART_TERMINATION=n

# General configuration
CONFIG_NCS_APPLICATION_BOOT_BANNER_STRING="Mesh Vendor Model Demo"
CONFIG_HEAP_MEM_POOL_SIZE=10240
CONFIG_SYSTEM_WORKQUEUE_STACK_SIZE=4096
CONFIG_FLASH=y
CONFIG_FLASH_MAP=y
CONFIG_NVS=y
CONFIG_SETTINGS=y
CONFIG_NVS_LOOKUP_CACHE=y
CONFIG_SETTINGS_NVS_NAME_CACHE=y
CONFIG_HWINFO=y
CONFIG_DK_LIBRARY=y
CONFIG_PM_PARTITION_SIZE_SETTINGS_STORAGE=0x8000
CONFIG_SOC_FLASH_NRF_PARTIAL_ERASE=y

# Bluetooth configuration
CONFIG_BT=y
CONFIG_BT_COMPANY_ID=0xFFFF
CONFIG_BT_DEVICE_NAME="Mesh Vendor Model Demo"
CONFIG_BT_L2CAP_TX_MTU=69
CONFIG_BT_L2CAP_TX_BUF_COUNT=8
CONFIG_BT_OBSERVER=y
CONFIG_BT_PERIPHERAL=y
CONFIG_BT_SETTINGS=y
# Increase RX stack size to avoid overflow during provisioning
CONFIG_BT_RX_STACK_SIZE=4096
CONFIG_BT_MESH_ADV_STACK_SIZE=4096
# Disable unused Bluetooth features
CONFIG_BT_CTLR_LE_ENC=n
CONFIG_BT_PHY_UPDATE=n
CONFIG_BT_CTLR_CHAN_SEL_2=n
CONFIG_BT_CTLR_MIN_USED_CHAN=n
CONFIG_BT_CTLR_PRIVACY=n

# Bluetooth Mesh configuration
CONFIG_BT_MESH=y
CONFIG_BT_MESH_RELAY=y
CONFIG_BT_MESH_FRIEND=n
CONFIG_BT_MESH_ADV_BUF_COUNT=20
CONFIG_BT_MESH_TX_SEG_MAX=32
CONFIG_BT_MESH_RX_SEG_MAX=32
CONFIG_BT_MESH_PB_GATT=y
CONFIG_BT_MESH_GATT_PROXY=y
CONFIG_BT_MESH_PROXY_USE_DEVICE_NAME=y
CONFIG_BT_MESH_DK_PROV=y
CONFIG_BT_MESH_MODEL_GROUP_COUNT=2

# Storage configuration
CONFIG_BT_MESH_RPL_STORE_TIMEOUT=10
CONFIG_BT_MESH_STORE_TIMEOUT=10

# Logging
CONFIG_LOG=y
CONFIG_LOG_PRINTK=y
CONFIG_LOG_DEFAULT_LEVEL=3
CONFIG_BT_MESH_MODEL_LOG_LEVEL_DBG=y

# CONFIG_NEWLIB_LIBC=y
```

## boards/nrf52840dk_nrf52840.conf
```kconfig
# #
# # Copyright (c) 2024 Nordic Semiconductor
# #
# # SPDX-License-Identifier: LicenseRef-Nordic-5-Clause

# # # Enable the UART driver
CONFIG_UART_ASYNC_API=y
CONFIG_UART_USE_RUNTIME_CONFIGURE=y

# # nRF52840DK uses RTT for logs.
CONFIG_LOG=y
CONFIG_USE_SEGGER_RTT=y
CONFIG_LOG_BACKEND_RTT=y
CONFIG_LOG_BACKEND_UART=n
CONFIG_LOG_PRINTK=n

CONFIG_SEGGER_RTT_BUFFER_SIZE_UP=4096
```

## boards/nrf54l15dk_nrf54l10_cpuapp.conf
```kconfig
#
# Copyright (c) 2024 Nordic Semiconductor
#
# SPDX-License-Identifier: LicenseRef-Nordic-5-Clause
#

# Disable the unspupported UART0 driver
CONFIG_NRFX_UARTE0=n
# Enable the UART driver
CONFIG_UART_ASYNC_API=y
CONFIG_SERIAL=y
CONFIG_UART_USE_RUNTIME_CONFIGURE=y

# nRF54L DK uses UART for logs.
CONFIG_SERIAL=y
CONFIG_CONSOLE=y
CONFIG_UART_CONSOLE=y

CONFIG_LOG=y
CONFIG_LOG_BACKEND_UART=y
CONFIG_LOG_BACKEND_SHOW_COLOR=n
CONFIG_LOG_BACKEND_FORMAT_TIMESTAMP=n
CONFIG_LOG_MODE_DEFERRED=y
CONFIG_LOG_PRINTK=y
CONFIG_LOG_BUFFER_SIZE=4096
CONFIG_LOG_PROCESS_THREAD_STACK_SIZE=1024
```

## boards/nrf52840dk_nrf52840.overlay
```dts
/*
 * Copyright (c) 2024 Nordic Semiconductor ASA
 *
 * SPDX-License-Identifier: LicenseRef-Nordic-5-Clause
 */

/ {
	chosen {
		nordic,nus-uart = &uart0;
		// zephyr,console = &uart1;
		// zephyr,shell-uart = &uart1;
		// zephyr,uart-mcumgr = &uart1;
		// zephyr,bt-mon-uart = &uart1;
		// zephyr,bt-c2h-uart = &uart1;
	};
};


&uart0 {
	current-speed = <9600>;
};

// &uart1 {
// 	compatible = "nordic,nrf-uarte";
// 	status = "okay";
// 	current-speed = <115200>;
// 	pinctrl-0 = <&uart1_default>;
// 	pinctrl-1 = <&uart1_sleep>;
// 	pinctrl-names = "default", "sleep";
// 	/delete-property/ hw-flow-control;
// };

// &pinctrl {
// 	uart1_default: uart1_default {
// 		group1 {
// 			psels = <NRF_PSEL(UART_RX, 1, 1)>;
// 			bias-pull-up;
// 		};
// 		group2 {
// 			psels = <NRF_PSEL(UART_TX, 1, 2)>;
// 		};
// 	};

// 	uart1_sleep: uart1_sleep {
// 		group1 {
// 			psels = <NRF_PSEL(UART_RX, 1, 1)>,
// 				<NRF_PSEL(UART_TX, 1, 2)>;
// 			low-power-enable;
// 		};
// 	};
// };
```

## src/main.c
```c
/*
 * Copyright (c) 2025 Nordic Semiconductor ASA
 *
 * SPDX-License-Identifier: LicenseRef-Nordic-5-Clause
 */

/** @file
 *  @brief Nordic Mesh Vendor Model Demo
 */
#include <zephyr/bluetooth/bluetooth.h>
#include <zephyr/bluetooth/mesh.h>
#include <dk_buttons_and_leds.h>
#include <bluetooth/mesh/dk_prov.h>
#include <zephyr/logging/log.h>

#include "uart_app.h"
#include "model_handler.h"
#include "node_app.h"
#include "nus_setting_app.h"

LOG_MODULE_REGISTER(peripheral_uart);

#define STACKSIZE 						0x2000
#define PRIORITY 						7

K_SEM_DEFINE(ble_init_ok, 0, 1);


void error(void)
{
	LOG_ERR("Panic!");

	while (true) {
		/* Spin for ever */
		k_sleep(K_MSEC(1000));
	}
}

static void bt_ready(int err)
{
	if (err) {
		printk("Bluetooth init failed (err: %d)", err);
		return;
	}

	printk("Bluetooth initialized");

	err = dk_leds_init();
	if (err) {
		printk("Failed to initialize LEDs (err: %d)", err);
		return;
	}

	err = bt_mesh_init(bt_mesh_dk_prov_init(), model_handler_init());
	if (err) {
		printk("Initializing mesh failed (err: %d)", err);
		return;
	}

	if (IS_ENABLED(CONFIG_SETTINGS)) {
		settings_load();
	}

	/* This will be a no-op if settings_load() loaded provisioning info */
	bt_mesh_prov_enable(BT_MESH_PROV_ADV | BT_MESH_PROV_GATT);

	printk("Mesh initialized\n");

	printk("Press Button 1 to send SET message\n");
	printk("Press Button 2 to send SET UNACK request\n");
	printk("Press Button 3 to send GET request\n");
}

int main(void)
{
	int err;

	LOG_INF("Initializing Vendor Model Demo, the version is %s", CONFIG_FW_VERSION);

	nus_settings_init();

	err = uart_init();
	if (err) {
		error();
	}

	err = bt_enable(bt_ready);
	if (err) {
		printk("Bluetooth init failed (err: %d)", err);
	}

	LOG_INF("Bluetooth initialized");

	k_sem_give(&ble_init_ok);

	node_app_init();

	return 0;
}

void ble_write_thread(void)
{
	/* Don't go any further until BLE is initialized */
	k_sem_take(&ble_init_ok, K_FOREVER);

	struct uart_data_t uart_data = {
		.len = 0,
	};

	for (;;) 
	{
		/* Wait for data from UART to be processed */
		struct uart_data_t *buf = k_fifo_get(&fifo_uart_rx_data, K_FOREVER);
		if(buf)
		{
			int plen = MIN(sizeof(uart_data.data) - uart_data.len, buf->len);
			int loc = 0;

			while (plen > 0) {
				memcpy(&uart_data.data[uart_data.len], &buf->data[loc], plen);
				uart_data.len += plen;
				loc += plen;
	#ifdef CONFIG_BT_NUS_CRLF_UART_TERMINATION
				if (uart_data.len >= sizeof(uart_data.data) ||
				(uart_data.data[uart_data.len - 1] == '\n') ||
				(uart_data.data[uart_data.len - 1] == '\r')) {
	#endif
					if(!transparent_flag)
					{
						handle_uart_data(&uart_data);		//handle uart command from host mcu
					}
					// else
					// {
					// 	ble_send_uart_data(uart_data.data, uart_data.len);
					// }
					
					uart_data.len = 0;
	#ifdef CONFIG_BT_NUS_CRLF_UART_TERMINATION
				}
	#endif
				plen = MIN(sizeof(uart_data.data), buf->len - loc);
			}

			k_free(buf);
		}
	}
}


K_THREAD_DEFINE(ble_write_thread_id, STACKSIZE, ble_write_thread, NULL, NULL,
		NULL, PRIORITY, 0, 0);
```

## include/vnd_cli.h
```c
/*
 * Copyright (c) 2025 Nordic Semiconductor ASA
 *
 * SPDX-License-Identifier: LicenseRef-Nordic-5-Clause
 */

#ifndef VND_CLI_H__
#define VND_CLI_H__

#include <zephyr/bluetooth/mesh.h>
#include <zephyr/kernel.h>
#include "vnd_common.h"

/**
 * @brief Vendor Client Model
 * @defgroup bt_mesh_vendor_cli Vendor Client Model
 * @{
 */

#ifdef __cplusplus
extern "C" {
#endif

/** Vendor Client Model Context */
struct bt_mesh_vendor_cli {
	/** Vendor model entry */
	const struct bt_mesh_model *model;
	/** Publish parameters */
	struct bt_mesh_model_pub pub;
	/** Publication message */
	struct net_buf_simple pub_msg;
	/** Publication message buffer */
	uint8_t buf[BT_MESH_VENDOR_MSG_MAXLEN_SET + 3 + 4];
	/** Acknowledged message tracking */
	struct bt_mesh_msg_ack_ctx ack_ctx;
	/** @brief Status message handler
	 *
	 * Called when a Vendor_Status message is received
	 *
	 * @param[in] cli    Vendor Client model
	 * @param[in] ctx    Message context
	 * @param[in] status Vendor status contained in the message
	 */
	void (*const status_handler)(struct bt_mesh_vendor_cli *cli,
			     struct bt_mesh_msg_ctx *ctx,
			     const struct bt_mesh_vendor_status *status);
};

/** @cond INTERNAL_HIDDEN */
extern const struct bt_mesh_model_op _bt_mesh_vendor_cli_op[];
extern const struct bt_mesh_model_cb _bt_mesh_vendor_cli_cb;
/** @endcond */

/** @def BT_MESH_VND_CLI_INIT
 *
 * @brief Initialization parameters for the @ref bt_mesh_vendor_cli.
 *
 * @param[in] _status_handler Optional status message handler.
 */
#define BT_MESH_VND_CLI_INIT(_status_handler)                                  \
	{                                                                      \
		.status_handler = _status_handler,                             \
	}

/** Vendor Client model composition data entry. */
#define BT_MESH_MODEL_VND_CLI(_cli)                                           \
	BT_MESH_MODEL_VND_CB(BT_COMP_ID_VENDOR, BT_MESH_MODEL_ID_VENDOR_CLI, \
			     _bt_mesh_vendor_cli_op, &(_cli)->pub,            \
			     BT_MESH_MODEL_USER_DATA(struct bt_mesh_vendor_cli, _cli), \
			     &_bt_mesh_vendor_cli_cb)

/** Default timeout for vendor client operations */
#define VND_CLI_TIMEOUT K_MSEC(5000)

/**
 * @brief Send a vendor set message
 *
 * @param cli      Vendor Client model
 * @param ctx      Message context, or NULL to use the configured publish parameters
 * @param set      Vendor set message to send
 * @return 0 on success, or negative error code otherwise
 */
int bt_mesh_vendor_cli_set(struct bt_mesh_vendor_cli *cli,
			   struct bt_mesh_msg_ctx *ctx,
			   const struct bt_mesh_vendor_set *set,
			   struct bt_mesh_vendor_status *rsp);

/**
 * @brief Send a vendor get message and wait for status response
 *
 * @param cli      Vendor Client model
 * @param ctx      Message context, or NULL to use the configured publish parameters
 * @param get      Vendor get message parameter (see @ref bt_mesh_vendor_get), can be NULL
 * @param rsp      Status response buffer, filled with the response data on success
 * @return 0 on success, or negative error code otherwise
 */
int bt_mesh_vendor_cli_get(struct bt_mesh_vendor_cli *cli,
			   struct bt_mesh_msg_ctx *ctx,
			   const struct bt_mesh_vendor_get *get,
			   struct bt_mesh_vendor_status *rsp);

/**
 * @brief Send a vendor set unacknowledged message
 *
 * @param cli      Vendor Client model
 * @param ctx      Message context, or NULL to use the configured publish parameters
 * @param set      Vendor set message to send
 * @return 0 on success, or negative error code otherwise
 */
int bt_mesh_vendor_cli_set_unack(struct bt_mesh_vendor_cli *cli,
			         struct bt_mesh_msg_ctx *ctx,
			         const struct bt_mesh_vendor_set *set);

#ifdef __cplusplus
}
#endif

/** @} */

#endif /* VND_CLI_H__ */
```

## include/vnd_common.h
```c
/*
 * Copyright (c) 2025 Nordic Semiconductor ASA
 *
 * SPDX-License-Identifier: LicenseRef-Nordic-5-Clause
 */

#ifndef VND_COMMON_H__
#define VND_COMMON_H__

#include <zephyr/bluetooth/mesh.h>
#include <zephyr/logging/log.h>


#define PRINT_HEX(p_label, p_text, len)\
	({\
		LOG_INF("---- %s (len: %u): ----", p_label, len);\
		LOG_HEXDUMP_INF(p_text, len, "Content:");\
		LOG_INF("---- %s end  ----", p_label);\
	})


/**
 * @brief Vendor Model common definitions
 * @defgroup bt_mesh_vendor_model Vendor Model common definitions
 * @{
 */

/* Company ID - using Nordic company ID */
#define BT_COMP_ID_VENDOR 0x0059

/* Vendor model IDs */
#define BT_MESH_MODEL_ID_VENDOR_SRV 0x1000
#define BT_MESH_MODEL_ID_VENDOR_CLI 0x1001

/* Vendor model opcodes */
#define BT_MESH_VENDOR_OP_SET 	      				BT_MESH_MODEL_OP_3(0x10, BT_COMP_ID_VENDOR)
#define BT_MESH_VENDOR_OP_SET_UNACK   				BT_MESH_MODEL_OP_3(0x11, BT_COMP_ID_VENDOR)
#define BT_MESH_VENDOR_OP_GET 	      				BT_MESH_MODEL_OP_3(0x12, BT_COMP_ID_VENDOR)
#define BT_MESH_VENDOR_OP_STATUS      				BT_MESH_MODEL_OP_3(0x13, BT_COMP_ID_VENDOR)
#define BT_MESH_VENDOR_OP_GET_NODE_DETAILS 	      	BT_MESH_MODEL_OP_3(0x14, BT_COMP_ID_VENDOR)
#define BT_MESH_VENDOR_OP_STATUS_NODE_DETAILS 		BT_MESH_MODEL_OP_3(0x15, BT_COMP_ID_VENDOR)
#define BT_MESH_VENDOR_OP_GET_METER_DATA 	      	BT_MESH_MODEL_OP_3(0x16, BT_COMP_ID_VENDOR)
#define BT_MESH_VENDOR_OP_STATUS_METER_DATA 		BT_MESH_MODEL_OP_3(0x17, BT_COMP_ID_VENDOR)

/* Maximum message length (excluding 3 byte opcode) is 377 bytes */
#define BT_MESH_VENDOR_MSG_MAXLEN_SET    (377)

/* Maximum message length (excluding 3 byte opcode) is sizeof(bt_mesh_vendor_get), i.e. 2 bytes */
#define BT_MESH_VENDOR_MSG_MAXLEN_GET    (2)

/* Status message max length (excluding 3 byte opcode) is 377 bytes */
#define BT_MESH_VENDOR_MSG_MAXLEN_STATUS (377)

/**
 * @brief Vendor Status Message
 *
 * This structure represents the status response from a vendor model server.
 */
struct bt_mesh_vendor_status {
	struct net_buf_simple *buf;
};

/**
 * @brief Vendor Set Message
 *
 * This structure represents the set message sent to a vendor model server.
 */
struct bt_mesh_vendor_set {
	struct net_buf_simple *buf;
};

/**
 * @brief Vendor Get Message types
 *
 * The type parameter specifies which status data to return.
 */
typedef enum bt_mesh_vendor_get_type {
    BT_MESH_VENDOR_GET_TYPE_STATUS = 0,
    BT_MESH_VENDOR_GET_TYPE_NODE_DETAILS,
    BT_MESH_VENDOR_GET_TYPE_METER_DATA,
} bt_mesh_vendor_get_type_t;

/**
 * @brief Vendor Get Message
 *
 * The length parameter specifies how much status data to return.
 */
struct bt_mesh_vendor_get {
	/** Length parameter */
	uint16_t length;
	bt_mesh_vendor_get_type_t type;
};

/** @} */

#endif /* VND_COMMON_H__ */
```

## include/vnd_srv.h
```c
/*
 * Copyright (c) 2025 Nordic Semiconductor ASA
 *
 * SPDX-License-Identifier: LicenseRef-Nordic-5-Clause
 */

#ifndef VND_SRV_H__
#define VND_SRV_H__

#include <zephyr/bluetooth/mesh.h>
#include "vnd_common.h"

/**
 * @brief Vendor Server Model
 * @defgroup bt_mesh_vendor_srv Vendor Server Model
 * @{
 */

#ifdef __cplusplus
extern "C" {
#endif

/* Forward declaration of vendor server model */
struct bt_mesh_vendor_srv;

/** @def BT_MESH_VENDOR_SRV_INIT
 *
 * @brief Initialization parameters for a @ref bt_mesh_vendor_srv instance.
 *
 * @param[in] _handlers Pointer to a handler function structure.
 */
#define BT_MESH_VENDOR_SRV_INIT(_handlers)                                    \
	{                                                                      \
		.handlers = _handlers,                                         \
	}

/** Vendor Server Model Handler functions */
struct bt_mesh_vendor_srv_handlers {
	/** @brief Set callback
	 *
	 * Called when a Vendor_Set message is received
	 *
	 * @param srv    Vendor Server model
	 * @param ctx    Message context
	 * @param set    Vendor set message received
	 * @param rsp    Vendor status message to be sent
	 *
	 * @return 0 on success, or negative error code to send response later or to skip response
	 */
	int (*const set)(struct bt_mesh_vendor_srv *srv,
			  struct bt_mesh_msg_ctx *ctx,
			  const struct bt_mesh_vendor_set *set,
			  struct bt_mesh_vendor_status *rsp);

	/** @brief Get callback
	 *
	 * Called when a Vendor_Get message is received
	 *
	 * @param srv    Vendor Server model
	 * @param ctx    Message context
	 * @param get    Vendor get message parameters, can be NULL
	 * @param rsp    Vendor status message to be sent
	 *
	 * @return 0 on success, or negative error code to send response later or to skip response
	 */
	int (*const get)(struct bt_mesh_vendor_srv *srv,
			  struct bt_mesh_msg_ctx *ctx,
			  const struct bt_mesh_vendor_get *get,
			  struct bt_mesh_vendor_status *rsp);
};

/** Vendor Server Model Context */
struct bt_mesh_vendor_srv {
	/** Application handler functions */
	const struct bt_mesh_vendor_srv_handlers *const handlers;
	/** Vendor model entry */
	const struct bt_mesh_model *model;
	/** Publish parameters */
	struct bt_mesh_model_pub pub;
	/** Publication message */
	struct net_buf_simple pub_msg;
	/** Publication message buffer */
	uint8_t buf[BT_MESH_VENDOR_MSG_MAXLEN_STATUS + 4];
	/** Status buffer */
	struct net_buf_simple status_msg;
	/** Current status data */
	uint8_t status_buf_data[BT_MESH_VENDOR_MSG_MAXLEN_STATUS + 4];
};

/** @cond INTERNAL_HIDDEN */
extern const struct bt_mesh_model_op _bt_mesh_vendor_srv_op[];
extern const struct bt_mesh_model_cb _bt_mesh_vendor_srv_cb;
/** @endcond */

/** Vendor Server model composition data entry. */
#define BT_MESH_MODEL_VND_SRV(srv, handlers)                                      \
	BT_MESH_MODEL_VND_CB(BT_COMP_ID_VENDOR, BT_MESH_MODEL_ID_VENDOR_SRV,  \
			     _bt_mesh_vendor_srv_op, &(srv)->pub,              \
			     (srv), &_bt_mesh_vendor_srv_cb)

/**
 * @brief Store model handlers in the server context
 *
 * This function should be called before the model is registered in the
 * composition data.
 *
 * @param srv      Vendor Server model
 * @param handlers Callbacks for the model instance
 */
static inline void bt_mesh_vendor_srv_set_handlers(struct bt_mesh_vendor_srv *srv,
                                                 const struct bt_mesh_vendor_srv_handlers *handlers)
{
    /* Cannot directly modify const pointer, use const_cast equivalent in C */
    *(const struct bt_mesh_vendor_srv_handlers **)&srv->handlers = handlers;
}

/**
 * @brief Send a status message
 *
 * @param srv Vendor Server model
 * @param ctx Message context to send with, or NULL to publish
 * @param rsp Vendor status message to be sent
 * @return 0 on success, or negative error code otherwise
 */
int bt_mesh_vendor_srv_status_send(struct bt_mesh_vendor_srv *srv,
                                   struct bt_mesh_msg_ctx *ctx,
                                   struct bt_mesh_vendor_status *rsp);



/**
 * @brief server model send message
 *
 * @param srv Vendor Server model
 * @param ctx Message context to send with, or NULL to publish
 * @param rsp Vendor status message to be sent
 * @return 0 on success, or negative error code otherwise
 */
int bt_mesh_vendor_srv_node_details_send(struct bt_mesh_vendor_srv *srv,
			   struct bt_mesh_msg_ctx *ctx,
			   struct bt_mesh_vendor_status *value);


/**
 * @brief Send a meter data message
 *
 * @param srv Vendor Server model
 * @param ctx Message context to send with, or NULL to publish
 * @param rsp Vendor status message to be sent
 * @return 0 on success, or negative error code otherwise
 */
int bt_mesh_vendor_srv_meter_data_send(struct bt_mesh_vendor_srv *srv,
                                   struct bt_mesh_msg_ctx *ctx,
                                   struct bt_mesh_vendor_status *rsp);

#ifdef __cplusplus
}
#endif

/** @} */

#endif /* VND_SRV_H__ */
```

## src/model_handler.c
```c
/*
 * Copyright (c) 2025 Nordic Semiconductor ASA
 *
 * SPDX-License-Identifier: LicenseRef-Nordic-5-Clause
 */

#include <zephyr/bluetooth/mesh.h>
#include <bluetooth/mesh/models.h>
#include <zephyr/bluetooth/bluetooth.h>
#include <zephyr/logging/log.h>
#include <string.h>
#include <dk_buttons_and_leds.h>
#include <zephyr/kernel.h>

#include "../include/vnd_srv.h"
#include "../include/vnd_cli.h"
#include "../include/vnd_common.h"
#include "model_handler.h"


LOG_MODULE_REGISTER(model_handler, CONFIG_BT_MESH_MODEL_LOG_LEVEL);

/* Sample message buffer */
static const char set_msg[] =
"Hello World- 0123456789ABCDEF0123456789ABCDEF0123456789ABCDEF0123456789ABCDEF0123456789ABCDEF0123456789ABCDEF0123456789ABCDEF0123456789ABCDEF0123456789ABCDEF0123456789ABCDEF0123456789ABCDEF0123456789ABCDEF0123456789ABCDEF0123456789ABCDEF0123456789ABCDEF0123456789ABCDEF0123456789ABCDEF0123456789ABCDEF";
static const char status_msg[] =
"Response OK- 0123456789ABCDEF0123456789ABCDEF0123456789ABCDEF0123456789ABCDEF0123456789ABCDEF0123456789ABCDEF0123456789ABCDEF0123456789ABCDEF0123456789ABCDEF0123456789ABCDEF0123456789ABCDEF0123456789ABCDEF0123456789ABCDEF0123456789ABCDEF0123456789ABCDEF0123456789ABCDEF0123456789ABCDEF0123456789ABCDEF";

/* Forward declaration for the client status handler */
static void handle_vendor_status(struct bt_mesh_vendor_cli *cli,
				  struct bt_mesh_msg_ctx *ctx,
				  const struct bt_mesh_vendor_status *status);

/* Vendor model operation callbacks */
static int handle_vendor_set(struct bt_mesh_vendor_srv *srv,
				struct bt_mesh_msg_ctx *ctx,
				const struct bt_mesh_vendor_set *set,
				struct bt_mesh_vendor_status *rsp);

static int handle_vendor_get(struct bt_mesh_vendor_srv *srv,
				struct bt_mesh_msg_ctx *ctx,
				const struct bt_mesh_vendor_get *get,
				struct bt_mesh_vendor_status *rsp);

static const struct bt_mesh_vendor_srv_handlers vendor_srv_handlers = {
	.set = handle_vendor_set,
	.get = handle_vendor_get,
};

/* Set up a repeating delayed work to blink the DK's LEDs when attention is requested. */
static struct k_work_delayable attention_blink_work;
static bool attention;

static void attention_blink(struct k_work *work)
{
	static bool led_on;

	if (attention) {
		led_on = !led_on;
		dk_set_led(0, led_on);

		struct k_work_delayable *dwork = k_work_delayable_from_work(work);
		k_work_schedule(dwork, K_MSEC(300));
	} else {
		dk_set_led(0, 0);
	}
}

/* Health Server callback */
static void attention_on(const struct bt_mesh_model *mod)
{
	attention = true;
	k_work_schedule(&attention_blink_work, K_NO_WAIT);
}

static void attention_off(const struct bt_mesh_model *mod)
{
	attention = false;
}

static const struct bt_mesh_health_srv_cb health_srv_cb = {
	.attn_on = attention_on,
	.attn_off = attention_off,
};

static struct bt_mesh_health_srv health_srv = {
	.cb = &health_srv_cb,
};

BT_MESH_HEALTH_PUB_DEFINE(health_pub, 0);

/**************************************************************************************************/
/* Server model instance */
static struct bt_mesh_vendor_srv vendor_srv = BT_MESH_VENDOR_SRV_INIT(&vendor_srv_handlers);

/* Server set callback */
static int handle_vendor_set(struct bt_mesh_vendor_srv *srv,
				struct bt_mesh_msg_ctx *ctx,
				const struct bt_mesh_vendor_set *set,
				struct bt_mesh_vendor_status *rsp)
{
	char data[BT_MESH_VENDOR_MSG_MAXLEN_SET + 1] = {0};
	size_t len = set->buf->len;

	/* Safety check for buffer size */
	if (len > BT_MESH_VENDOR_MSG_MAXLEN_SET) {
		len = BT_MESH_VENDOR_MSG_MAXLEN_SET;
	}

	/* Copy data for display */
	if (len > 0) {
		memcpy(data, set->buf->data, len);
		data[len] = '\0'; /* Null-terminate the string */
	}

	LOG_INF("Received SET message: \"%s\"", data);

	/* Populate the response status message */
	net_buf_simple_reset(rsp->buf);
	net_buf_simple_add_mem(rsp->buf, status_msg, strlen(status_msg));

	return 0; /* Return success to send response immediately */
}

/* Server get callback */
static int handle_vendor_get(struct bt_mesh_vendor_srv *srv,
				struct bt_mesh_msg_ctx *ctx,
				const struct bt_mesh_vendor_get *get,
				struct bt_mesh_vendor_status *rsp)
{
	size_t len = strlen(status_msg);

	/* Check if length parameter is provided and limit response accordingly */
	if (get) {
		len = (get->length < len) ? get->length : len;

		LOG_INF("GET with length: %u", get->length);
	} else {
		LOG_INF("GET without length, sending full response");
	}

	/* Populate the response status message */
	switch(get->type) {
	case BT_MESH_VENDOR_GET_TYPE_STATUS:
		net_buf_simple_reset(rsp->buf);
		net_buf_simple_add_u8(rsp->buf, BT_MESH_VENDOR_GET_TYPE_STATUS);
		net_buf_simple_add_mem(rsp->buf, status_msg, len);
		LOG_INF("GET request for status");
		break;
	case BT_MESH_VENDOR_GET_TYPE_NODE_DETAILS:	
		net_buf_simple_reset(rsp->buf);
		net_buf_simple_add_mem(rsp->buf, &node_details, sizeof(node_info_t));
		// net_buf_simple_add_le64(rsp->buf, node_details.serial_number);
		// net_buf_simple_add_le16(rsp->buf, node_details.mesh_address);
		// net_buf_simple_add_u8(rsp->buf, node_details.capacity);
		// net_buf_simple_add_u8(rsp->buf, node_details.quality);
		LOG_INF("GET request for node details");
		break;
	case BT_MESH_VENDOR_GET_TYPE_METER_DATA:
		net_buf_simple_reset(rsp->buf);
		net_buf_simple_add_u8(rsp->buf, BT_MESH_VENDOR_GET_TYPE_METER_DATA);
		net_buf_simple_add_mem(rsp->buf, status_msg, len);
		LOG_INF("GET request for meter data");
		break;
	default:
		LOG_WRN("Unknown GET request type: %d", get->type);
		return -EINVAL; /* Invalid request type */
	}

	LOG_INF("Sending STATUS response with length: %zu", len);

	return 0; /* Return success to send response immediately */
}

/**************************************************************************************************/
/* Client model instance */
static struct bt_mesh_vendor_cli vendor_cli = BT_MESH_VND_CLI_INIT(handle_vendor_status);

/* Client status callback */
static void handle_vendor_status(struct bt_mesh_vendor_cli *cli,
				  struct bt_mesh_msg_ctx *ctx,
				  const struct bt_mesh_vendor_status *status)
{
	char data[BT_MESH_VENDOR_MSG_MAXLEN_STATUS + 1] = {0};
	size_t len = status->buf->len;

	if (len > BT_MESH_VENDOR_MSG_MAXLEN_STATUS) {
		len = BT_MESH_VENDOR_MSG_MAXLEN_STATUS;
	}

	if (len > 0) {
		memcpy(data, status->buf->data, len);
		data[len] = '\0'; /* Null-terminate the string */
	}

	LOG_INF("Received STATUS response: \"%s\"", data);	
}


int vendor_model_send_set(const uint8_t *data, size_t len, struct bt_mesh_vendor_status *rsp)
{
	LOG_INF("Sending SET message: \"%s\"", (char *)data);

	NET_BUF_SIMPLE_DEFINE(temp_buf, BT_MESH_VENDOR_MSG_MAXLEN_SET);
	net_buf_simple_add_mem(&temp_buf, data, len);

	struct bt_mesh_vendor_set set = {
		.buf = &temp_buf
	};

	return bt_mesh_vendor_cli_set(&vendor_cli, NULL, &set, rsp);
}

int vendor_model_send_set_unack(const uint8_t *data, size_t len)
{
	LOG_INF("Sending SET UNACK message: \"%s\"", (char *)data);

	NET_BUF_SIMPLE_DEFINE(temp_buf, BT_MESH_VENDOR_MSG_MAXLEN_SET);
	net_buf_simple_add_mem(&temp_buf, data, len);

	struct bt_mesh_vendor_set set = {
		.buf = &temp_buf
	};

	return bt_mesh_vendor_cli_set_unack(&vendor_cli, NULL, &set);
}


int vendor_model_send_get(bt_mesh_vendor_get_type_t type, uint16_t addr, uint16_t len)
{
	// LOG_INF("Sending GET message with length: %u", len);
	/* Send GET message with length parameter set to 1 */
	struct bt_mesh_msg_ctx ctx = {
		.addr = addr,
		.app_idx = vendor_cli.model->keys[0],
		.send_ttl = BT_MESH_TTL_DEFAULT,
		.send_rel = true,
    };

	struct bt_mesh_vendor_get get = {
		.length = len,
		.type = type,
	};

	return bt_mesh_vendor_cli_get(&vendor_cli, &ctx, &get, NULL);
}


/** Send an node details message to all nodes. */
int vendor_model_publish_messages(const node_info_t *data, size_t len)
{
	NET_BUF_SIMPLE_DEFINE(pub_buf, BT_MESH_VENDOR_MSG_MAXLEN_SET);
	net_buf_simple_add_mem(&pub_buf, data, len);
	// net_buf_simple_add_le64(&pub_buf, data->serial_number);
    // net_buf_simple_add_le16(&pub_buf, data->mesh_address);
    // net_buf_simple_add_u8(&pub_buf, data->capacity);
    // net_buf_simple_add_u8(&pub_buf, data->quality);

	struct bt_mesh_vendor_status details = {
		.buf = &pub_buf
	};

	return bt_mesh_vendor_srv_node_details_send(&vendor_srv, NULL, &details);
}


/* Handle button events */
static void button_handler(uint32_t pressed, uint32_t changed)
{
	int err;

	if (pressed & changed & BIT(DK_BTN1)) {
		/* Send SET message with "Hello World" string */
		err = vendor_model_send_set((const uint8_t *)set_msg, strlen(set_msg), NULL);
		if (err) {
			LOG_ERR("Failed to send SET message (err: %d)", err);
		}
	}

	if (pressed & changed & BIT(DK_BTN2)) {
		/* Send SET UNACK message with "Hello World" string */
		err = vendor_model_send_set_unack((const uint8_t *)set_msg, strlen(set_msg));
		if (err) {
			LOG_ERR("Failed to send SET UNACK message (err: %d)", err);
		}
	}
	if (pressed & changed & BIT(DK_BTN3)) {
		// /* Send GET message to request status */
		// err = bt_mesh_vendor_cli_get(&vendor_cli, NULL, NULL, NULL);
		// if (err) {
		// 	LOG_ERR("Failed to send GET message (err: %d)", err);
		// }

		/* publish node details to All Nodes */
		err = publish_node_details();
		if (err) {
			LOG_ERR("Failed to send GET message (err: %d)", err);
		}
	}
	if (pressed & changed & BIT(DK_BTN4)) {
		/* Send GET message with length parameter */
		struct bt_mesh_vendor_get get = {
			.length = sizeof(status_msg),
			.type = BT_MESH_VENDOR_GET_TYPE_STATUS,
		};

		err = bt_mesh_vendor_cli_get(&vendor_cli, NULL, &get, NULL);
		if (err) {
			LOG_ERR("Failed to send GET message with length (err: %d)", err);
		}
	}
}

/**************************************************************************************************/
/* Composition data element for the server model */
static const struct bt_mesh_elem elements[] = {
	BT_MESH_ELEM(
		1, BT_MESH_MODEL_LIST(
			BT_MESH_MODEL_CFG_SRV,
			BT_MESH_MODEL_HEALTH_SRV(&health_srv, &health_pub)),
		BT_MESH_MODEL_LIST(
			BT_MESH_MODEL_VND_SRV(&vendor_srv, &vendor_srv_handlers),
			BT_MESH_MODEL_VND_CLI(&vendor_cli))
	),
};

/* Composition data for the mesh node */
static const struct bt_mesh_comp comp = {
	.cid = BT_COMP_ID_VENDOR,
	.elem = elements,
	.elem_count = ARRAY_SIZE(elements),
};

const struct bt_mesh_comp *model_handler_init(void)
{
	int err;

	err = dk_leds_init();
	if (err) {
		LOG_ERR("Failed to initialize LEDs (err: %d)", err);
	}

	err = dk_buttons_init(button_handler);
	if (err) {
		LOG_ERR("Failed to initialize buttons (err: %d)", err);
	}

	k_work_init_delayable(&attention_blink_work, attention_blink);

	return &comp;
}
```

## src/model_handler.h
```c
/*
 * Copyright (c) 2025 Nordic Semiconductor ASA
 *
 * SPDX-License-Identifier: LicenseRef-Nordic-5-Clause
 */

#ifndef MODEL_HANDLER_H__
#define MODEL_HANDLER_H__

#include <zephyr/bluetooth/mesh.h>
#include "vnd_cli.h"
#include "node_app.h"

/**
 * @brief Initialize the model handler module
 *
 * @return The Bluetooth Mesh composition data for the node
 */
const struct bt_mesh_comp *model_handler_init(void);

/**
 * @brief Send a Vendor Set message
 *
 * @param data     Data to send
 * @param len      Length of data
 * @param rsp      Pointer to response buffer, or NULL to not wait for response
 * @return 0 on success, negative error code otherwise
 */
int vendor_model_send_set(const uint8_t *data, size_t len, struct bt_mesh_vendor_status *rsp);

/**
 * @brief Send a Vendor Get message
 *
 * @param type     Vendor Get Message types
 * @param addr     Vdestination node address
 * @param len      Length of get message
 * @return 0 on success, negative error code otherwise
 */
int vendor_model_send_get(bt_mesh_vendor_get_type_t type, uint16_t addr, uint16_t len);

/**
 * @brief Send a Vendor Set Unacknowledged message
 *
 * @param data     Data to send
 * @param len      Length of data
 * @return 0 on success, negative error code otherwise
 */
int vendor_model_send_set_unack(const uint8_t *data, size_t len);

/**
 * @brief Server publish the node details message to all nodes
 *
 * @param data     Data to send
 * @param len      Length of data to be sent
 * @return 0 on success, negative error code otherwise
 */
int vendor_model_publish_messages(const node_info_t *data, size_t len);

#endif /* MODEL_HANDLER_H__ */
```

## src/node_app.c
```c
#include <zephyr/kernel.h>
#include <zephyr/bluetooth/mesh/access.h>
#include <stdint.h>
#include <string.h>
#include <stdlib.h> 

#include "node_app.h"
#include "model_handler.h"


#include <zephyr/logging/log.h>
LOG_MODULE_DECLARE(model_handler, CONFIG_BT_MESH_MODEL_LOG_LEVEL);

#define MAX_DELAY_SECONDS 100


node_info_t node_details = {0};

static node_table_t node_table[NODE_INFO_TABLE_SIZE];

/* Set up a repeating delayed work to publish node details to All Nodes. */
static struct k_work_delayable node_update_work;


void node_path_table_init(void) 
{
    for (int i = 0; i < NODE_INFO_TABLE_SIZE; ++i) 
    {
        memset(&node_table[i], 0, sizeof(node_table_t));
    }
}

bool is_node_sn_valid(uint8_t *arr)
{
    for (size_t i = 0; i < DEVICE_SN_SIZE; i++) 
    {
        if (arr[i] != 0) {
            return true;  
        }
    }
    return false;
}

void update_node_path_table(node_info_t new_node) 
{
    int64_t current_time = k_uptime_get();

    if(memcmp(new_node.serial_number, node_details.serial_number, DEVICE_SN_SIZE) == 0 ||
         !is_node_sn_valid(new_node.serial_number))
    {
        // Do not update the table with own node info or empty serial number
        LOG_DBG("Skipping update for own node or empty serial number.");
        return;
    }

    // Try to find existing entry
    for (int i = 0; i < NODE_INFO_TABLE_SIZE; ++i) 
    {
        // if (node_table[i].node_info.serial_number == new_node.serial_number) 
        if(memcmp(new_node.serial_number, node_table[i].node_info.serial_number, DEVICE_SN_SIZE) == 0)
        {
            node_table[i].node_info = new_node;
            node_table[i].timestamp = current_time;
            return;
        }
    }

    // Try to find an empty slot
    for (int i = 0; i < NODE_INFO_TABLE_SIZE; ++i) 
    {
        // if (node_table[i].node_info.serial_number == 0) 
        if(!is_node_sn_valid(node_table[i].node_info.serial_number)) 
        {
            node_table[i].node_info = new_node;
            node_table[i].timestamp = current_time;
            return;
        }
    }

    // If table is full, optionally replace the oldest entry
    int oldest_index = 0;
    int64_t oldest_time = node_table[0].timestamp;
    for (int i = 1; i < NODE_INFO_TABLE_SIZE; ++i) 
    {
        if (node_table[i].timestamp < oldest_time) 
        {
            oldest_time = node_table[i].timestamp;
            oldest_index = i;
        }
    }

    node_table[oldest_index].node_info = new_node;
    node_table[oldest_index].timestamp = current_time;
}

void print_node_path_table(void) 
{
    LOG_INF("Node Path Table:");
    for (int i = 0; i < NODE_INFO_TABLE_SIZE; ++i) 
    {
        // if (node_table[i].node_info.serial_number != 0) 
        if(is_node_sn_valid(node_table[i].node_info.serial_number))
        {
            LOG_INF("Index %d: Serial: 0X%02X%02X%02X%02X%02X%02X, Mesh Addr: 0x%04X, Capacity: %u, Quality: %u, Timestamp: %d",
                    i,
                    node_table[i].node_info.serial_number[0],node_table[i].node_info.serial_number[1],
                    node_table[i].node_info.serial_number[2],node_table[i].node_info.serial_number[3],
                    node_table[i].node_info.serial_number[4],node_table[i].node_info.serial_number[5],
                    node_table[i].node_info.mesh_address,
                    node_table[i].node_info.capacity,
                    node_table[i].node_info.quality,
                    node_table[i].timestamp);
        }
    }
}


void purge_obsolete_node_info(void) 
{
    int64_t now = k_uptime_seconds();

    for (int i = 0; i < NODE_INFO_TABLE_SIZE; ++i) 
    {
        // if (node_table[i].node_info.serial_number != 0 &&
        //     (now - node_table[i].timestamp) > NODE_INFO_TIMEOUT) 
        if(is_node_sn_valid(node_table[i].node_info.serial_number) &&
           (now - node_table[i].timestamp) > NODE_INFO_TIMEOUT) 
        {
            // Mark entry as empty
            memset(&node_table[i], 0, sizeof(node_table_t));
        }
    }
}


uint16_t get_remote_node_addr(uint8_t *serial_number)
{
    for (int i = 0; i < NODE_INFO_TABLE_SIZE; ++i) 
    {
        // if (node_table[i].node_info.serial_number == serial_number) 
        if(memcmp(serial_number, node_table[i].node_info.serial_number, DEVICE_SN_SIZE) == 0)
        {
            return node_table[i].node_info.mesh_address;
        }
    }
    return 0; // Not found
}


int publish_node_details(void)
{
    if (!bt_mesh_is_provisioned()) 
    {
        LOG_ERR("Mesh is not provisioned, cannot publish node details.");
        return -ENOTCONN;
    }
    
    node_details.mesh_address = bt_mesh_primary_addr();
    // Publish the node details to all nodes
    int err = vendor_model_publish_messages(&node_details, sizeof(node_info_t));
    if (err) 
    {
        LOG_ERR("Failed to publish node details: %d", err);
        return err;
    }

    LOG_INF("Node details published successfully.");
    return 0;
}

static void update_node_details(struct k_work *work)
{
    // Remove obsolete node info entries every 1h
    purge_obsolete_node_info();     

    publish_node_details();
   
    // Reschedule for 60 minutes later
    struct k_work_delayable *dwork = k_work_delayable_from_work(work);
    k_work_schedule(dwork, K_MINUTES(60)); 
}


void node_app_init(void) 
{
    // node_details.serial_number = get_device_sn(); // Load device serial number from settings
    memcpy(node_details.serial_number, get_device_sn(), DEVICE_SN_SIZE);
    if(bt_mesh_is_provisioned())
    {
        node_details.mesh_address = bt_mesh_primary_addr();
    }

    // start work queue with random delay up to 100s
    uint8_t delay_s = (rand() % (MAX_DELAY_SECONDS + 1));
    k_timeout_t delay = K_SECONDS(delay_s);
    // Initialize the node path table
    node_path_table_init();

    // Initialize the delayed work for publishing node details
    k_work_init_delayable(&node_update_work, update_node_details);

    // Schedule the first publication of node details
    k_work_schedule(&node_update_work, delay);
}
```

## src/node_app.h
```c
#ifndef __NODE_APP_H_
#define __NODE_APP_H_

#include <zephyr/kernel.h>
#include "nus_setting_app.h"


#define NODE_INFO_TABLE_SIZE            10
#define NODE_INFO_TIMEOUT               (60 * 60)  // 1 hour in seconds

typedef struct {
    uint8_t serial_number[DEVICE_SN_SIZE]; // Device serial number
    uint16_t mesh_address;
    uint8_t capacity;  // Capacity for cellular network
    uint8_t quality;    // Status of the node (e.g., online, offline)  
} node_info_t;


typedef struct {
    node_info_t node_info;
    uint32_t timestamp;
} node_table_t;

extern node_info_t node_details;

extern void node_app_init(void);

extern int publish_node_details(void);

extern void node_path_table_init(void);

extern void update_node_path_table(node_info_t new_node);

extern void print_node_path_table(void);

extern uint16_t get_remote_node_addr(uint8_t *serial_number);


#endif
```

## src/nus_setting_app.c
```c
#include <zephyr/kernel.h>
#include <zephyr/settings/settings.h>
#include <zephyr/device.h>
#include <zephyr/devicetree.h>
#include <zephyr/logging/log.h>
#include "nus_setting_app.h"

LOG_MODULE_DECLARE(peripheral_uart);

#define STORAGE_PARTITION	    storage_partition
#define STORAGE_PARTITION_ID	FIXED_PARTITION_ID(STORAGE_PARTITION)

static uint8_t new_mac[6] = {0};
static uint32_t new_baudrate = 0;
static uint8_t serial_number[DEVICE_SN_SIZE] = {0};

static int nus_settings_set(const char *name, size_t len, settings_read_cb read_cb,
					 void *cb_arg)
{
	const char *next;
    int rc = 0;

	// LOG_INF("set handler name=%s, len=%d \n", (name), len);
	if (settings_name_steq(name, "mac_address", &next) && !next)
	{
		if (len != sizeof(new_mac))
		{
			return -EINVAL;
		}
		rc = read_cb(cb_arg, new_mac, sizeof(new_mac));
        if(rc >= 0)
        {
             /* key-value pair was properly read. rc contains value length.*/
            LOG_INF("mac: %02X:%02X:%02X:%02X:%02X:%02X\n", new_mac[0], new_mac[1], new_mac[2], new_mac[3], new_mac[4], new_mac[5]);
		    return 0;
        }
	}

    if (settings_name_steq(name, "baudrate", &next) && !next)
	{
		if (len != sizeof(new_baudrate))
		{
			return -EINVAL;
		}
		rc = read_cb(cb_arg, &new_baudrate, sizeof(new_baudrate));
        if(rc >= 0)
        {
             /* key-value pair was properly read. rc contains value length.*/
            LOG_INF("baudrate: %d\n", new_baudrate);
		    return 0;
        }
	}

    if (settings_name_steq(name, "sn", &next) && !next)
	{
		if (len != sizeof(serial_number))
		{
			return -EINVAL;
		}
		rc = read_cb(cb_arg, serial_number, sizeof(serial_number));
        if(rc >= 0)
        {
             /* key-value pair was properly read. rc contains value length.*/
            LOG_INF("serial_number: 0x%02X%02X%02X%02X%02X%02X\n", serial_number[0], serial_number[1], 
                    serial_number[2], serial_number[3], serial_number[4], serial_number[5]);
		    return 0;
        }
	}

	return -ENOENT;
}


static int nus_settings_export(int (*storage_func)(const char *name,
    const void *value,
    size_t val_len))
{
    int err = 0;
    err = storage_func("nus/mac_address", new_mac, sizeof(new_mac));
    err += storage_func("nus/baudrate", &new_baudrate, sizeof(new_baudrate));
    err += storage_func("nus/sn", serial_number, sizeof(serial_number));
    return  err;
}

struct settings_handler nus_conf = {
    .name = "nus",
    .h_set = nus_settings_set,
    .h_export = nus_settings_export
};


int save_mac_address(uint8_t *mac, uint8_t len)
{
    int err = 0;

    if(len != sizeof(new_mac))
    {
        return -EINVAL;
    }
    memcpy(new_mac, mac, sizeof(new_mac));
    err = settings_save_one("nus/mac_address", new_mac, sizeof(new_mac));
    if(err)
    {
        LOG_ERR("Failed to save mac address");
    }

    return err;
}

int16_t save_new_baudrate(uint8_t *data, uint8_t len)
{
	int16_t err = 0;
	if(len != sizeof(new_baudrate))
    {
        return -EINVAL;
    }

	new_baudrate = (data[0] << 24) | (data[1] << 16) | (data[2] << 8) | data[3];
	LOG_INF("Baudrate set to: %d", new_baudrate);
	if(new_baudrate < 1200 || new_baudrate > 1000000)
	{
		LOG_WRN("Invalid baudrate value!");
		err = -EINVAL;
	}
	
	err = settings_save_one("nus/baudrate", &new_baudrate, sizeof(new_baudrate));
	return err;
}

int16_t save_device_sn(uint8_t *data, uint8_t len)
{
	int16_t err = 0;
	if(len != DEVICE_SN_SIZE)
    {
        LOG_ERR("rec_len: %d, sn_len: %d\n", len, sizeof(serial_number));
        return -EINVAL;
    }

	// serial_number = (data[0] << 24) | (data[1] << 16) | (data[2] << 8) | data[3];
    memcpy(serial_number, data, len);
	err = settings_save_one("nus/sn", serial_number, sizeof(serial_number));
	return err;
}


uint8_t * get_mac_address(void)
{
    if(settings_load_subtree("nus/mac_address"))
    {
        LOG_ERR("Failed to load nus settings");
        return NULL;
    }
    // LOG_INF("get mac: %02X:%02X:%02X:%02X:%02X:%02X\n", new_mac[0], new_mac[1], new_mac[2], new_mac[3], new_mac[4], new_mac[5]);
    return new_mac;
}

uint32_t get_uart_baudrate(void)
{
	if(settings_load_subtree("nus/baudrate"))
    {
        LOG_ERR("Failed to load nus settings");
        return 9600;
    }
    LOG_INF("get baudrate: %d\n", new_baudrate);

	new_baudrate = ((new_baudrate > 1200 && new_baudrate < 1000000) ? new_baudrate : 9600);
	
    return new_baudrate;
}

uint8_t * get_device_sn(void)
{
	if(settings_load_subtree("nus/sn"))
    {
        LOG_ERR("Failed to load nus settings");
        return 0;
    }
    LOG_INF("get device_sn: 0x%02X%02X%02X%02X%02X%02X\n", serial_number[0], serial_number[1], 
            serial_number[2], serial_number[3], serial_number[4], serial_number[5]);
	
    return serial_number;
}


void nus_settings_init(void)
{
    settings_subsys_init();
    settings_register(&nus_conf);
}
```

## src/nus_setting_app.h
```c
/*
 * Copyright (c) 2018 Nordic Semiconductor ASA
 *
 * SPDX-License-Identifier: LicenseRef-Nordic-5-Clause
 */

 #ifndef __NUS_SETTING_APP_H_
 #define __NUS_SETTING_APP_H_
 
#define DEVICE_SN_SIZE          6

 int save_mac_address(uint8_t *mac, uint8_t len);

 int16_t save_new_baudrate(uint8_t *data, uint8_t len);

 int16_t save_device_sn(uint8_t *data, uint8_t len);

 uint8_t * get_mac_address(void);

 uint32_t get_uart_baudrate(void);

 uint8_t * get_device_sn(void);

 void nus_settings_init(void);

 #endif
```

## src/path_table.c
```c
#include <zephyr/kernel.h>
#include <stdint.h>
#include <string.h>

#include "path_table.h"


static node_info_t node_info_table[NODE_INFO_TABLE_SIZE];


void node_path_table_init(void) {
    for (int i = 0; i < NODE_INFO_TABLE_SIZE; ++i) {
        node_info_table[i].serial_number = 0;
    }
}



void update_node_path_table(uint64_t serial_number, uint16_t src_address) {
    int64_t current_time = k_uptime_get();

    // Try to find existing entry
    for (int i = 0; i < NODE_INFO_TABLE_SIZE; ++i) {
        if (node_info_table[i].serial_number == serial_number) {
            node_info_table[i].mesh_address = src_address;
            node_info_table[i].timestamp = current_time;
            return;
        }
    }

    // Try to find an empty slot
    for (int i = 0; i < NODE_INFO_TABLE_SIZE; ++i) {
        if (node_info_table[i].serial_number == 0) {
            node_info_table[i].serial_number = serial_number;
            node_info_table[i].mesh_address = src_address;
            node_info_table[i].timestamp = current_time;
            return;
        }
    }

    // If table is full, optionally replace the oldest entry
    int oldest_index = 0;
    int64_t oldest_time = node_info_table[0].timestamp;
    for (int i = 1; i < NODE_INFO_TABLE_SIZE; ++i) {
        if (node_info_table[i].timestamp < oldest_time) {
            oldest_time = node_info_table[i].timestamp;
            oldest_index = i;
        }
    }

    node_info_table[oldest_index].serial_number = serial_number;
    node_info_table[oldest_index].mesh_address = src_address;
    node_info_table[oldest_index].timestamp = current_time;
}



void purge_obsolete_node_info(void) {
    int64_t now = k_uptime_seconds();

    for (int i = 0; i < NODE_INFO_TABLE_SIZE; ++i) {
        if (node_info_table[i].serial_number != 0 &&
            (now - node_info_table[i].timestamp) > NODE_INFO_TIMEOUT) {

            // Mark entry as empty
            node_info_table[i].serial_number = 0;
            node_info_table[i].mesh_address = 0;
            node_info_table[i].timestamp = 0;
        }
    }
}
```

## src/path_table.h
```c
#ifndef __PATH_TABLE_H_
#define __PATH_TABLE_H_

#include <zephyr/kernel.h>

#define NODE_INFO_TABLE_SIZE 10
#define NODE_INFO_TIMEOUT (60 * 60)  // 1 hour in seconds

typedef struct {
    uint64_t serial_number;
    uint16_t mesh_address;
    uint32_t timestamp;
} node_info_t;


#endif
```
